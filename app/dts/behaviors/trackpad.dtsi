/*
 * Copyright (c) 2024 The ZMK Contributors
 *
 * SPDX-License-Identifier: MIT
 */

/ {
    behaviors {
        /omit-if-no-ref/ tp: trackpad {
            compatible = "zmk,behavior-trackpad";
            #binding-cells = <1>;
        };
    };
};
