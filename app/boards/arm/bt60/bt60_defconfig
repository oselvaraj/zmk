## app/boards/arm/bt60/bt60_defconfig
```kconfig
# SPDX-License-Identifier: MIT

CONFIG_SOC_SERIES_NRF52X=y
CONFIG_SOC_NRF52840_QIAA=y
CONFIG_BOARD_BT60=y

# Enable MPU
CONFIG_ARM_MPU=y

# enable GPIO
CONFIG_GPIO=y

CONFIG_PINCTRL=y

CONFIG_ZMK_USB_LOGGING=y

CONFIG_ZMK_TRACKPAD=y
CONFIG_ZMK_TRACKPAD_TICK_DURATION=3
CONFIG_ZMK_TRACKPAD_PHYSICAL_X=650
CONFIG_ZMK_TRACKPAD_PHYSICAL_Y=1065
CONFIG_ZMK_TRACKPAD_LOGICAL_X=700
CONFIG_ZMK_TRACKPAD_LOGICAL_Y=1200
CONFIG_I2C=y
CONFIG_GEN4=y
CONFIG_GEN4_TRIGGER_GLOBAL_THREAD=y
#CONFIG_SENSOR_LOG_LEVEL_DBG=y

CONFIG_USE_DT_CODE_PARTITION=y

CONFIG_MPU_ALLOW_FLASH_WRITE=y
CONFIG_NVS=y
CONFIG_SETTINGS_NVS=y
CONFIG_FLASH=y
CONFIG_FLASH_PAGE_LAYOUT=y
CONFIG_FLASH_MAP=y

CONFIG_BT_CTLR_TX_PWR_PLUS_8=y

CONFIG_BUILD_OUTPUT_UF2=y
```

## app/dts/bindings/behaviors/zmk,behavior-trackpad.yaml
```yaml
# Copyright (c) 2024 The ZMK Contributors
# SPDX-License-Identifier: MIT

description: Trackpad

compatible: "zmk,behavior-trackpad"

include: one_param.yaml
```
